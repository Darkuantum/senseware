## senseware_code/sdkconfig.defaults
```kconfig
# Bluetooth stack configuration
# BLE removed from firmware — these flags remain as safety nets
# to prevent Bluedroid from attempting OBEX/L2CAP init at boot
CONFIG_BTDM_CTRL_MODE_BLE_ONLY=y
CONFIG_BTDM_CTRL_BR_EDR_DISABLED=y
CONFIG_BT_NIMBLE_ENABLED=0
```
